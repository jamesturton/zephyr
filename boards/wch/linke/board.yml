## boards/wch/linke/board.yml
```yaml
board:
  name: linke
  full_name: WCH LinkE
  vendor: wch
  socs:
    - name: ch32v305
```

## soc/wch/ch32v/qingke_v4f/Kconfig.soc.ch32v305
```kconfig
# Copyright (c) 2025 MASSDRIVER EI (massdriver.space)
# SPDX-License-Identifier: Apache-2.0

config SOC_CH32V305
	bool
	select SOC_SERIES_QINGKE_V4F

config SOC
	default "ch32v305" if SOC_CH32V305
```
